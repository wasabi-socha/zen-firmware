#include "zen.dtsi"
#include <input/processors.dtsi>
#include <dt-bindings/zmk/input_transform.h>

&pointing_listener {
    input-processors =
        <&zip_xy_transform (INPUT_TRANSFORM_X_INVERT | INPUT_TRANSFORM_Y_INVERT)>,
        <&zip_temp_layer 1 500>;

    scroller {
        layers = <4>;
        input-processors =
            <&zip_xy_transform (INPUT_TRANSFORM_Y_INVERT)>,
            <&zip_xy_to_scroll_mapper>,
            <&scroll_scaler 1 28>;
        process-next;
    };
};

&zen_transform {
    col-offset = <7>;
};

// タイピング中にトラックボール/トラックパッドへ触れてマウスレイヤーが誤発動するのを防ぐ
&zip_temp_layer {
    // 最後の打鍵から400msはマウスレイヤーに切り替えない(カーソル移動はする)
    require-prior-idle-ms = <400>;
    // マウスレイヤー中に押しても解除しないキー(クリック類・Shift/Ctrl/Win/Alt)
    // それ以外のキーを押すと通常レイヤーへ即戻る
    excluded-positions = <7 8 9 18 19 20 21 22 32 24 37 38 39 40>;
};
